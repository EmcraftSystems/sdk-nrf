## lib/app_workq/Kconfig
```kconfig
#
# Copyright (c) 2025 Emcraft Systems
#
# SPDX-License-Identifier: Apache-2.0
#

config APP_WORK_QUEUE
	bool "Generic work queue with low priority"
	help
	  Enable generic application work queue

config APP_WORK_QUEUE_STACK_SIZE
	int "App work queue stack size"
	default 3072
	help
	  Stack size for the application work queue
```

## samples/bootloader/Kconfig
```kconfig
config PRINT_RESET_REASON
        bool "Enable print/clear reset reason"
        default n

menu "Zephyr Kernel"
source "Kconfig.zephyr"
endmenu
```

## subsys/net/lib/nrf_provisioning/Kconfig.nrf_provisioning_cbor
```kconfig
#
# Copyright (c) 2023 Nordic Semiconductor
#
# SPDX-License-Identifier: LicenseRef-Nordic-5-Clause
#
menuconfig NRF_PROVISIONING_CBOR
	bool "nRF Provisioning CBOR content format"
	select EXPERIMENTAL
	depends on ZCBOR

if NRF_PROVISIONING_CBOR

config NRF_PROVISIONING_CBOR_RECORDS
	int "Maximum number of CBOR records that can be encoded or decoded at a time"
	default 10

config NRF_PROVISIONING_CBOR_PROP_COUNT
	int "Maximum number of configuration properties that can be received"
	default 100

endif
```
